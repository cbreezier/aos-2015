## apps/test/Kconfig
```kconfig
config APP_TESTAPP
    bool "test app"
    depends on LIB_SEL4 && HAVE_LIBC && LIB_SOS
    select HAVE_SEL4_APPS
    help
        A new test app
```

## apps/timer/Kconfig
```kconfig
config APP_TIMERAPP
    bool "timer app"
    depends on LIB_SEL4 && HAVE_LIBC && LIB_SOS
    select HAVE_SEL4_APPS
    help
        A timer driver used to aid SOS
```
